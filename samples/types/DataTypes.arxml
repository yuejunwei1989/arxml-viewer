AUTOSAR XML (schema 4.0)
package /DataTypes
  4 x app type, all with category=VALUE:
    VehicleSpeed_T: base-type=uint16, compu-method=kmh_CompuMethod, unit=kilometer_per_hour, data-constr=Speed_DataConstr
    EngineSpeed_T: base-type=uint16, unit=rpm
    Temperature_T: base-type=sint16, unit=degree_Celsius
    Boolean_T: base-type=boolean
  application record data type VehicleStatus_T: category=STRUCTURE
    4 x application record element:
      Speed: type=VehicleSpeed_T
      EngineSpeed: type=EngineSpeed_T
      CoolantTemp: type=Temperature_T
      IsRunning: type=Boolean_T
  application array data type WheelSpeedArray_T: category=ARRAY
    application array element WheelSpeed: type=VehicleSpeed_T
  impl type DiagRequest_T: category=VALUE, base-type=uint8
  impl type DiagResult_T: category=VALUE, base-type=uint8
package /Interfaces
  sender receiver interface VehicleStatus_I
    data Status: type=VehicleStatus_T
    data WheelSpeeds: type=WheelSpeedArray_T
  sender receiver interface VehicleSpeed_I
    data VehicleSpeed: type=VehicleSpeed_T, init-value=0
    data SpeedValid: type=Boolean_T
  client server interface Diagnostics_I: is-service=true
    operation ReadFaultMemory
      arg requestId: type=DiagRequest_T, direction=IN
      arg result: type=DiagResult_T, direction=OUT
    operation ClearFaultMemory
      arg groupId: type=DiagRequest_T, direction=IN
