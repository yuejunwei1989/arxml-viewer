AUTOSAR XML (schema 4.0)
package /Powertrain
  application sw component type EngineControl
    provide port EngineSpeed_P: provided-interface=/Powertrain/EngineSpeed_I
