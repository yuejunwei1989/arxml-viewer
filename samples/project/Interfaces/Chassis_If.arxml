AUTOSAR XML (schema 4.0)
package /Chassis
  sender receiver interface VehicleSpeed_I
    data VehicleSpeed
  sender receiver interface BrakePressure_I
    data BrakePressure
