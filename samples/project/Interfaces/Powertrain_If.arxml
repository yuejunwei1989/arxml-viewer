AUTOSAR XML (schema 4.0)
package /Powertrain
  sender receiver interface EngineSpeed_I
    data EngineSpeed
    data EngineSpeedValid
  sender receiver interface ThrottlePosition_I
    data ThrottlePosition
  sender receiver interface GearPosition_I
    data Gear
