AUTOSAR XML (schema 4.0)
package /Vehicle
  composition sw component type VehicleTop
    provide port GearPosition_P: provided-interface=/Powertrain/GearPosition_I
    6 x component:
      Engine: type=EngineControl
      Transmission: type=TransmissionControl
      Wheel: type=WheelSpeedSensor
      ABS: type=ABSCtrl
      Brake: type=BrakeActuator
      Ghost: type=GhostComponent
    connect {context-component=/Vehicle/VehicleTop/Engine, target-port=/Vehicle/VehicleTop/Engine/EngineSpeed_P} -> {context-component=/Vehicle/VehicleTop/Transmission, target-port=/Vehicle/VehicleTop/Transmission/EngineSpeed_R}
    connect {context-component=/Vehicle/VehicleTop/Engine, target-port=/Vehicle/VehicleTop/Engine/ThrottlePosition_P} -> {context-component=/Vehicle/VehicleTop/Transmission, target-port=/Vehicle/VehicleTop/Transmission/ThrottlePosition_R}
    connect {context-component=/Vehicle/VehicleTop/Wheel, target-port=/Vehicle/VehicleTop/Wheel/VehicleSpeed_P} -> {context-component=/Vehicle/VehicleTop/ABS, target-port=/Vehicle/VehicleTop/ABS/VehicleSpeed_R}
    connect {context-component=/Vehicle/VehicleTop/ABS, target-port=/Vehicle/VehicleTop/ABS/BrakePressure_P} -> {context-component=/Vehicle/VehicleTop/Brake, target-port=/Vehicle/VehicleTop/Brake/BrakePressure_R}
    connect {context-component=/Vehicle/VehicleTop/Brake, target-port=/Vehicle/VehicleTop/Brake/NoSuchPort} -> {context-component=/Vehicle/VehicleTop/ABS, target-port=/Vehicle/VehicleTop/ABS/BrakePressure_P}
    delegate /Vehicle/VehicleTop/GearPosition_P <-> outer port GearPosition_P
