AUTOSAR XML (schema 4.0)
package /AppComponents
  application sw component type HmiPanel
    provide port TempReq_P: provided-interface=/AppComponents/TempRequest_I
  application sw component type BlowerActuator
    require port Blower_R: required-interface=/AppComponents/BlowerCmd_I
  composition sw component type ClimateComposition
    component Hmi: type=HmiPanel
    component Climate: type=ClimateControl
    component Blower: type=BlowerActuator
    connect {context-component=/AppComponents/ClimateComposition/Hmi, target-port=/AppComponents/ClimateComposition/Hmi/TempReq_P} -> {context-component=/AppComponents/ClimateComposition/Climate, target-port=/AppComponents/ClimateComposition/Climate/TempReq_R}
    connect {context-component=/AppComponents/ClimateComposition/Climate, target-port=/AppComponents/ClimateComposition/Climate/Blower_P} -> {context-component=/AppComponents/ClimateComposition/Blower, target-port=/AppComponents/ClimateComposition/Blower/Blower_R}
