AUTOSAR XML (schema 4.0)
package /AppComponents
  application sw component type DoorSensor
    provide port DoorState_P: provided-interface=/AppComponents/DoorState_I
  application sw component type KeyReceiver
    provide port RemoteKey_P: provided-interface=/AppComponents/RemoteKey_I
  composition sw component type BodyComposition
    component Sensor: type=DoorSensor
    component Key: type=KeyReceiver
    component Body: type=BodyControl
    connect {context-component=/AppComponents/BodyComposition/Sensor, target-port=/AppComponents/BodyComposition/Sensor/DoorState_P} -> {context-component=/AppComponents/BodyComposition/Body, target-port=/AppComponents/BodyComposition/Body/DoorState_P}
    connect {context-component=/AppComponents/BodyComposition/Key, target-port=/AppComponents/BodyComposition/Key/RemoteKey_P} -> {context-component=/AppComponents/BodyComposition/Body, target-port=/AppComponents/BodyComposition/Body/RemoteKey_R}
