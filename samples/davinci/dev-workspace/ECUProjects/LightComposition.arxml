AUTOSAR XML (schema 4.0)
package /ComponentTypes
  composition sw component type LightComposition
    component Logic: type=LightControl
    component Reader: type=SwitchReader
    component Driver: type=LampDriver
    connect {context-component=/ComponentTypes/LightComposition/Reader, target-port=/ComponentTypes/LightComposition/Reader/Switch_P} -> {context-component=/ComponentTypes/LightComposition/Logic, target-port=/ComponentTypes/LightComposition/Logic/Switch_R}
    connect {context-component=/ComponentTypes/LightComposition/Logic, target-port=/ComponentTypes/LightComposition/Logic/LampCmd_P} -> {context-component=/ComponentTypes/LightComposition/Driver, target-port=/ComponentTypes/LightComposition/Driver/LampCmd_R}
