AUTOSAR XML (schema 4.0)
package /PortInterfaces
  sender receiver interface LightSwitch_I
    data SwitchPosition
  sender receiver interface LampCmd_I
    data Brightness
    data BlinkActive
  sender receiver interface AmbientLight_I
    data LuxValue
